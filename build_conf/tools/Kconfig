## build_conf/tools/Kconfig
```kconfig
mainmenu "Welcome to use eziot-sdk MenuConfig"


menu "Basic Config"
config BASIC_MESSAGE_MAXSIZE
    int "Maximum link message size"
	default 16384

config BASIC_LINK_TASK_STACK_SIZE
    int "Link task stack size"
	default 16384


endmenu

menu "TSL Component Config"	
config COMPONENT_TSL_ENABLE
    bool "Enable TSL Component"
	default n

config COMPONENT_TSL_PROFILE_ENABLE
    bool "Enable feature description file"
    depends on COMPONENT_TSL_ENABLE
	default n

config COMPONENT_TSL_PROFILE_STRIP
    bool "Use a simplified version of the feature description file"
    depends on COMPONENT_TSL_ENABLE
	default n

config COMPONENT_TSL_CONN_ENABLE
    bool "enable getway linkage"
    depends on COMPONENT_TSL_ENABLE
	default n

config COMPONENT_TSL_SHADOW_TASK_STACK_SIZE
    int "Shadow task stack size"
    depends on COMPONENT_TSL_ENABLE
	default 16384

endmenu	

menu "HUB Component Config"	
config COMPONENT_HUB_SUBLIST_MAX
    int "Maximum number of sub-devices"
	default 64
endmenu	
```
